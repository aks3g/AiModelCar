/*
 * read_parameters_from_sdc.cpp
 *
 * Created: 2015/04/12 20:59:25
 *  Author: sazae7
 */ 
#include <stdlib.h>
#include <string.h>

#include <userland.h>
#include <parameter.h>

/*---------------------------------------------------------------------------*/
/*---------------------------------------------------------------------------*/
volatile static uint8_t sRunning = 0;

/*---------------------------------------------------------------------------*/
/*---------------------------------------------------------------------------*/
uint32_t max_duty = 80;
uint32_t max_battery_voltage = 2900;
uint32_t min_battery_voltage = 2000;

/*---------------------------------------------------------------------------*/
//J 名前の一致する変数に値を入れる箇所
static void sCheckAndStoreParam(char *name, int16_t val)
{
	//J Vattery が最大電圧である場合のDuty比
	if (strcmp("max_duty", name) == 0) {
		max_duty = (uint32_t)val;
	}
	//J Vatteryの最大電圧[mV]
	else if (strcmp("max_battery_voltage", name) == 0) {
		max_battery_voltage = (uint32_t)val;
	}
	//J Vatteryの最終電圧[mV]
	else if (strcmp("min_battery_voltage", name) == 0) {
		min_battery_voltage = (uint32_t)val;
	}

	return;
}

/*---------------------------------------------------------------------------*/
/*---------------------------------------------------------------------------*/
void initialize_userland(void)
{
	FIL paramFile;
	
	//J パラメータファイルからパラメータを読み込む
	char fileName[16] = "param.txt";
	int8_t ret = f_open(&paramFile, fileName, FA_READ);
	if (ret == FR_OK) {
		char line[100];
		while (f_gets(line, 100, &paramFile) != NULL) {
			setupParams(line, sCheckAndStoreParam);
		}

		f_close(&paramFile);
		} else {
	}

	return;
}

/*---------------------------------------------------------------------------*/
void updateUserland(void)
{
	return;
}


/*---------------------------------------------------------------------------*/
/*---------------------------------------------------------------------------*/
uint8_t onSensorInterrupt(void *sensor)
{
	uint8_t duty = 100;

	if (sRunning) {
		duty =  max_duty;
	}
	else {
		duty =  0;
	}

	return duty;
}

/*---------------------------------------------------------------------------*/
/*---------------------------------------------------------------------------*/
void onTimerInterrupt(uint32_t tick)
{

}


/*---------------------------------------------------------------------------*/
/*---------------------------------------------------------------------------*/
void onSw0Pressed(void)
{
	sRunning = 1 - sRunning;
	gpio_output_toggle(nDEBUG_LED0_PORT, nDEBUG_LED0_PIN);
}

/*---------------------------------------------------------------------------*/
void onSw0Repeat(void)
{
	
}

/*---------------------------------------------------------------------------*/
void onSw0Released(void)
{

}


/*---------------------------------------------------------------------------*/
/*---------------------------------------------------------------------------*/
void onSw1Pressed(void)
{

}

/*---------------------------------------------------------------------------*/
void onSw1Repeat(void)
{
	
}

/*---------------------------------------------------------------------------*/
void onSw1Released(void)
{

}

/*---------------------------------------------------------------------------*/
/*---------------------------------------------------------------------------*/
void onSw2Pressed(void)
{

}

/*---------------------------------------------------------------------------*/
void onSw2Repeat(void)
{

}

/*---------------------------------------------------------------------------*/
void onSw2Released(void)
{

}
